#include <Wire.h>
#include <Adafruit_GFX.h>
#include <Adafruit_SSD1306.h>

#define TCAADDR 0x70 // I2C Multiplexer ADDR
#define DEBOUNCE_DELAY 100 // Extended debounce delay (100ms)

#define SCREEN_WIDTH 128 // OLED display width, in pixels
#define SCREEN_HEIGHT 64 // OLED display height, in pixels
#define OLED_RESET    -1 // Reset pin # (or -1 if unused)

// Create an array of display objects for each screen
Adafruit_SSD1306 display128x64(SCREEN_WIDTH, SCREEN_HEIGHT, &Wire, OLED_RESET);

// Bitmap example for the displays (replace with your actual bitmaps)
const uint8_t myBitmap1[] PROGMEM = {
0x00, 0x00, 0x00, 0x00, 0x3f, 0xff, 0xff, 0xff, 0xff, 0x00, 0x00, 0x00, 0x00, 0x00, 0x00, 0x00, 
0x00, 0x00, 0x00, 0x00, 0x7f, 0xff, 0xff, 0xff, 0xff, 0x80, 0x00, 0x00, 0x00, 0x00, 0x00, 0x00, 
0x00, 0x00, 0x00, 0x00, 0xff, 0xff, 0xff, 0xff, 0xff, 0xc0, 0x00, 0x00, 0x00, 0x00, 0x00, 0x00, 
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0x00, 0x00, 0x00, 0x00, 0x3f, 0xff, 0xff, 0xff, 0xff, 0xfe, 0x00, 0x00, 0x00, 0x00, 0x00, 0x00
/* Bitmap data for display 0 */ };
const uint8_t myBitmap2[] PROGMEM = {
0x00, 0x00, 0x00, 0x00, 0x00, 0x00, 0x00, 0xff, 0xff, 0x00, 0x00, 0x00, 0x00, 0x00, 0x00, 0x00, 
0x00, 0x00, 0x00, 0x00, 0x00, 0x00, 0x07, 0xff, 0xff, 0xe0, 0x00, 0x00, 0x00, 0x00, 0x00, 0x00, 
0x00, 0x00, 0x00, 0x00, 0x00, 0x00, 0x3f, 0xff, 0xff, 0xfc, 0x00, 0x00, 0x00, 0x00, 0x00, 0x00, 
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0x00, 0x00, 0x00, 0x00, 0x00, 0x00, 0x00, 0xe3, 0xff, 0x00, 0x00, 0x00, 0x00, 0x00, 0x00, 0x00
 /* Bitmap data for display 1 */ };
const uint8_t myBitmap3[] PROGMEM = {
0x00, 0x00, 0x00, 0x00, 0x00, 0x00, 0x00, 0x00, 0x00, 0x00, 0x00, 0x00, 0x00, 0x00, 0x00, 0x00, 
0x00, 0x00, 0x00, 0x00, 0x00, 0x00, 0x00, 0x00, 0x00, 0x00, 0x00, 0x00, 0x00, 0x00, 0x00, 0x00, 
0x00, 0x00, 0x00, 0x00, 0x00, 0x00, 0x00, 0x00, 0x00, 0x00, 0x00, 0x00, 0x00, 0x00, 0x00, 0x00, 
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0x00, 0x00, 0x00, 0x00, 0x00, 0x00, 0x00, 0x00, 0x00, 0x00, 0x00, 0x00, 0x00, 0x00, 0x00, 0x00
 /* Bitmap data for display 2 */ };
const uint8_t myBitmap4[] PROGMEM = {
0x00, 0x00, 0x00, 0x00, 0x00, 0xff, 0xff, 0xff, 0xff, 0xff, 0xff, 0x00, 0x00, 0x00, 0x00, 0x00, 
0x00, 0x00, 0x00, 0x00, 0x01, 0xff, 0xff, 0xff, 0xff, 0xff, 0xff, 0x80, 0x00, 0x00, 0x00, 0x00, 
0x00, 0x00, 0x00, 0x00, 0x03, 0xff, 0xff, 0xff, 0xff, 0xff, 0xff, 0xc0, 0x00, 0x00, 0x00, 0x00, 
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0x00, 0x00, 0x00, 0x00, 0x00, 0xff, 0xff, 0xff, 0xff, 0xff, 0xff, 0x00, 0x00, 0x00, 0x00, 0x00
/* Bitmap data for display 3 */ };
const uint8_t myBitmap5[] PROGMEM = {
0x00, 0x00, 0x00, 0x00, 0x00, 0x00, 0x00, 0x00, 0x00, 0x00, 0x00, 0x00, 0x00, 0x00, 0x00, 0x00, 
0x00, 0x00, 0x00, 0x00, 0x00, 0x00, 0x00, 0x00, 0x00, 0x00, 0x00, 0x00, 0x00, 0x00, 0x00, 0x00, 
0x00, 0x00, 0x00, 0x00, 0x00, 0x00, 0x00, 0x00, 0x00, 0x00, 0x00, 0x00, 0x00, 0x00, 0x00, 0x00, 
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0x00, 0x00, 0x00, 0x00, 0x00, 0x00, 0x00, 0x00, 0x00, 0x00, 0x00, 0x00, 0x00, 0x00, 0x00, 0x00  
 /* Bitmap data for display 4 */ };

// Create display structure
struct display {
    Adafruit_SSD1306 *display;
    uint8_t i2cnum;
};

#define NUMSCREENS 6
display OLEDS[NUMSCREENS] = {
    { &display128x64, 0 },
    { &display128x64, 1 },
    { &display128x64, 2 },
    { &display128x64, 3 },
    { &display128x64, 4 },
    { &display128x64, 5 },
};

// Button pins
#define BUTTON1_PIN 13
#define BUTTON2_PIN 12
#define BUTTON3_PIN 11
#define BUTTON4_PIN 10
#define BUTTON5_PIN 9
#define BUTTON6_PIN 8

// Potentiometer pin
#define POT_PIN A0

int lastPotValue = -1; // Store the last processed potentiometer value
int potValues[5] = {0}; // Moving average buffer for potentiometer
uint8_t potIndex = 0;   // Current index in the buffer

// Button state tracking
bool lastButtonState[6] = {true, true, true, true, true, true};

// Select multiplexer channel
void tcaselect(uint8_t i) {
    if (i > 7) return;
    Wire.beginTransmission(TCAADDR);
    Wire.write(1 << i);
    Wire.endTransmission();
}

// Setup each display with its unique bitmap
void setupDisplays() {
    for (uint8_t i = 0; i < NUMSCREENS; i++) {  // Corrected to NUMSCREENS
        tcaselect(i); // Select the corresponding channel
        OLEDS[i].display->begin(SSD1306_SWITCHCAPVCC, 0x3C); // Initialize with I2C address 0x3C
        OLEDS[i].display->clearDisplay(); // Clear display
        
        // Display the respective bitmap
        if (i == 0) {
            OLEDS[i].display->drawBitmap(0, 0, myBitmap1, 128, 64, WHITE);
        } else if (i == 1) {
            OLEDS[i].display->drawBitmap(0, 0, myBitmap2, 128, 64, WHITE);
        } else if (i == 2) {
            OLEDS[i].display->drawBitmap(0, 0, myBitmap3, 128, 64, WHITE);
        } else if (i == 3) {
            OLEDS[i].display->drawBitmap(0, 0, myBitmap4, 128, 64, WHITE);
        } else if (i == 4) {
            OLEDS[i].display->drawBitmap(0, 0, myBitmap5, 128, 64, WHITE);
        }
        
        OLEDS[i].display->display(); // Update display
    }
}


// Display a volume bar
void displayVolumeBar(uint8_t screenIndex, int volume) {
    // Ensure volume is between 0 and 100
    volume = constrain(volume, 0, 100);

    // Select the correct display
    tcaselect(screenIndex); // Select the correct channel of the multiplexer

    // Clear the display
    OLEDS[screenIndex].display->clearDisplay();

    // Draw the outer bar (background)
    OLEDS[screenIndex].display->drawRect(10, 25, 108, 14, WHITE); // Rectangle for the bar

    // Calculate the width of the filled bar based on the volume (from 0 to 100)
    int barWidth = map(volume, 0, 100, 0, 108);

    // Ensure that barWidth is never greater than 108 to prevent overflow
    barWidth = constrain(barWidth, 0, 108);

    // Draw the filled portion of the bar
    OLEDS[screenIndex].display->fillRect(10, 25, barWidth, 14, WHITE); // Filled rectangle

    // Optionally, add some shading or effects for the border or bar
    OLEDS[screenIndex].display->drawRect(10, 25, 108, 14, WHITE); // Uncomment to re-add border

    // Display the updated content on the screen
    OLEDS[screenIndex].display->display();
}



// Scan for I2C devices
void scanI2C() {
    Serial.println("Scanning I2C addresses...");
    for (uint8_t i = 0; i < 8; i++) { // Scan through all 8 channels of the multiplexer
        tcaselect(i); // Select the channel
        Serial.print("Channel ");
        Serial.print(i);
        Serial.println(":");

        for (uint8_t address = 1; address < 127; address++) { // Scan all possible I2C addresses
            Wire.beginTransmission(address);
            if (Wire.endTransmission() == 0) { // Address responded to the I2C request
                Serial.print("Found device at address 0x");
                Serial.println(address, HEX); // Print the address
            }
        }
    }
}

void setup() {
    Wire.begin();
    Serial.begin(9600);

    scanI2C();

    // Initialize buttons
    pinMode(BUTTON1_PIN, INPUT_PULLUP);
    pinMode(BUTTON2_PIN, INPUT_PULLUP);
    pinMode(BUTTON3_PIN, INPUT_PULLUP);
    pinMode(BUTTON4_PIN, INPUT_PULLUP);
    pinMode(BUTTON5_PIN, INPUT_PULLUP);
    pinMode(BUTTON6_PIN, INPUT_PULLUP);

    // Initialize displays with bitmaps
    setupDisplays();

    // Initialize the volume bar on screen 6 at the beginning
    displayVolumeBar(5, 0); // Set initial volume to 0 (empty bar)
}

void loop() {
    unsigned long currentMillis = millis();

    // Potentiometer handling with smoothing
    int rawPotValue = analogRead(POT_PIN);
    potValues[potIndex] = rawPotValue;
    potIndex = (potIndex + 1) % 5;

    // Calculate smoothed potentiometer value
    int smoothedValue = 0;
    for (int i = 0; i < 5; i++) {
        smoothedValue += potValues[i];
    }
    smoothedValue /= 5;

    int mappedValue = map(smoothedValue, 0, 1023, 0, 100);

    // Threshold to update only when a significant change occurs
    if (abs(mappedValue - lastPotValue) > 10) { // Update only if change is greater than 10 units
        Serial.print("Volume: ");
        Serial.println(mappedValue);
        displayVolumeBar(5, mappedValue); // Volume bar on screen 6
        lastPotValue = mappedValue;
    }

    // Button handling with debouncing
    bool currentButtonState[6] = {
        digitalRead(BUTTON1_PIN),
        digitalRead(BUTTON2_PIN),
        digitalRead(BUTTON3_PIN),
        digitalRead(BUTTON4_PIN),
        digitalRead(BUTTON5_PIN),
        digitalRead(BUTTON6_PIN)
    };

    const char *appMessages[] = {"APP1", "MUTE", "APP3", "APP4", "APP5", "APP6"};

    for (int i = 0; i < 6; i++) {
        if (!currentButtonState[i] && lastButtonState[i]) { // Detect button press (falling edge)
            Serial.println(appMessages[i]);
            delay(DEBOUNCE_DELAY); // Add debounce delay to avoid multiple detections
        }
        lastButtonState[i] = currentButtonState[i]; // Update button state
    }
     
}
